#include <ezButton.h>

#include <SPI.h>
#include <Wire.h>
#include <Adafruit_GFX.h>
#include <Adafruit_SSD1306.h>

#define SCREEN_WIDTH 128 // OLED display width, in pixels
#define SCREEN_HEIGHT 64 // OLED display height, in pixels

// I hope this code brings some love and peace to this mad world we live in <3

// Declaration for an SSD1306 display connected to I2C (SDA, SCL pins)
#define OLED_RESET     -1 // Reset pin # (or -1 if sharing Arduino reset pin)
Adafruit_SSD1306 display(SCREEN_WIDTH, SCREEN_HEIGHT, &Wire, OLED_RESET);

// 'chronic-snoop', 128x64px
const unsigned char epd_bitmap_chronic_snoop [] PROGMEM = {
	0xfe, 0xdb, 0x5a, 0xaa, 0xaa, 0xaa, 0xaa, 0xaa, 0xa8, 0xdf, 0x20, 0x03, 0xff, 0xff, 0xff, 0xff, 
	0xeb, 0x6d, 0x6b, 0x55, 0x55, 0x54, 0x91, 0x55, 0x6a, 0xb8, 0xb2, 0x4a, 0xaa, 0xaa, 0xaa, 0xab, 
	0xfd, 0xb6, 0xad, 0x6a, 0xaa, 0xaa, 0x4a, 0x55, 0xa0, 0xa2, 0xb4, 0x01, 0xdd, 0xdd, 0xff, 0xfe, 
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	0x54, 0xa0, 0x10, 0x0a, 0x94, 0x92, 0x91, 0x00, 0x80, 0x00, 0x5b, 0x40, 0x00, 0x20, 0xb0, 0xef
};

// Floats for ADC voltage & Input voltage
float adc_voltage = 0.0;
float in_voltage = 0.0;
 
// Floats for resistor values in divider (in ohms)
float R1 = 30000.0;
float R2 = 7500.0; 
 
// Float for Reference Voltage
float ref_voltage = 5.0;
 
// Integer for ADC value
int adc_value = 0;
 

const int PIN_RED   = 4;
const int PIN_GREEN = 3;
const int PIN_BLUE  = 5;
const int PIN_HEATER  = 2;
const int ButtonPin = 7;
const int VoltageSensorPIN = 6;
ezButton button(ButtonPin);  // create ezButton object that attach to pin 7;
bool fire = false;
float loopTime;
float firedstarted;
long pulseOvenTime = 750; //adjust this value to change speed of pulse


void setup() {

  pinMode(PIN_HEATER,   OUTPUT);
  pinMode(PIN_RED,   OUTPUT);
  pinMode(PIN_GREEN, OUTPUT);
  pinMode(PIN_BLUE,  OUTPUT);
  button.setDebounceTime(50); // set debounce time to 50 milliseconds


 Serial.begin(115200);
   // SSD1306_SWITCHCAPVCC = generate display voltage from 3.3V internally
  if(!display.begin(SSD1306_SWITCHCAPVCC, 0x3C)) { 
    Serial.println(F("SSD1306 allocation failed"));
    for(;;); // Don't proceed, loop forever
  }
  display.clearDisplay();
  
  // Draw bitmap on the screen
  display.drawBitmap(0, 0, epd_bitmap_chronic_snoop, 128, 64, 1);
  display.display();
  delay(5000);
}

void loop() {
 button.loop(); // MUST call the loop() function first#

    adc_value = analogRead(VoltageSensorPIN);
   adc_voltage  = (adc_value * ref_voltage) / 1024.0; 
   in_voltage = adc_voltage / (R2/(R1+R2)); 


  loopTime = millis();

display.clearDisplay();
display.drawRoundRect(83, 4, 2, 7, 1, WHITE);
display.drawRoundRect(85, 0, 43, 15, 3, WHITE);
display.setTextSize(1);
display.setTextColor(WHITE);     
display.setCursor(87, 4);             
display.println(in_voltage, 2);
display.setCursor(119,4);             
display.println("v");
display.setCursor(0,10);             
display.println("millis");
display.setCursor(0,20);             
display.println(loopTime);


 if(button.isPressed()) {
    fire = !fire;
    firedstarted = loopTime;
 }

  if(fire) {

    if(loopTime - firedstarted < pulseOvenTime){
      digitalWrite(PIN_HEATER, HIGH);
      analogWrite(PIN_RED,   255);
      analogWrite(PIN_GREEN, 0);
      analogWrite(PIN_BLUE,  0); 
    }
    else{
      digitalWrite(PIN_HEATER, LOW);
      analogWrite(PIN_RED,   0);
      analogWrite(PIN_GREEN, 255);
      analogWrite(PIN_BLUE,  128);
    }

    if (loopTime - firedstarted > pulseOvenTime*2){
      firedstarted = loopTime;
    }

    display.setCursor(0,30);             
    display.println(loopTime-firedstarted);
  }
  else {
    digitalWrite(PIN_HEATER, LOW);
    analogWrite(PIN_RED,   0);
    analogWrite(PIN_GREEN, 255);
    analogWrite(PIN_BLUE,  128);
    firedstarted = 0;
  }
  display.display();
}
